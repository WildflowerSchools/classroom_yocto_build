## meta-wildflower/conf/layer.conf
```bitbake
# We have a conf and classes directory, add to BBPATH
BBPATH .= ":${LAYERDIR}"

# We have recipes-* directories, add to BBFILES
BBFILES += "${LAYERDIR}/recipes-*/*/*.bb \
	${LAYERDIR}/recipes-*/*/*.bbappend"

LAYERSERIES_COMPAT_wildflower = "thud"

BBFILE_COLLECTIONS += "wildflower"
BBFILE_PATTERN_wildflower = "^${LAYERDIR}/"
BBFILE_PRIORITY_wildflower = "6"
```
